## meta-coolstream/conf/layer.conf
```bitbake
LCONF_VERSION = "7"

BBPATH .= ":${LAYERDIR}"
BBFILES += "${LAYERDIR}/recipes-*/*/*.bb ${LAYERDIR}/recipes-*/*/*/*.bb"

BBFILE_COLLECTIONS += "coolstream"
BBFILE_PATTERN_coolstream := "^${LAYERDIR}/"
BBFILE_PRIORITY_coolstream = "12"

LAYERSERIES_COMPAT_coolstream = "kirkstone"

# Custom licenses (if needed)
# LICENSE_PATH += "${LAYERDIR}/files/custom-licenses"
```

## meta-coolstream/conf/machine/coolstream-apollo.conf
```bitbake
#@TYPE: Machine
#@NAME: Coolstream Tank (apollo, uClibc toolchain)
#@DESCRIPTION: Coolstream Tank (HD2, Cortex-A9, uClibc/external toolchain)

require conf/machine/include/tune-cortexa9hf-neon.inc

SOC_FAMILY = "coolstream"
MACHINE_FEATURES = "screen usbhost usbgadget ext2 nfs"

# uClibc external toolchain for HD2 generation
TCLIBC ?= "uclibc"
TCMODE ?= "external-coolstream"

IMAGE_FSTYPES ?= "tar.gz"
KERNEL_IMAGETYPE ?= "zImage"

SERIAL_CONSOLES ?= "115200;ttyAS0"

PREFERRED_PROVIDER_virtual/kernel ?= "linux-coolstream"
PREFERRED_VERSION_virtual/kernel ?= "3.10.93"

MACHINEOVERRIDES =. "${MACHINE}:coolstream:coolstream-hd2:apollo:"
```

## meta-coolstream/conf/machine/coolstream-kronos.conf
```bitbake
#@TYPE: Machine
#@NAME: Coolstream Zee² / Trinity V2 (kronos, uClibc toolchain)
#@DESCRIPTION: Coolstream Zee² / Trinity V2 (HD2, Cortex-A9, uClibc/external toolchain)

require conf/machine/include/arm/armv7a/tune-cortexa9.inc

# Coolstream toolchain is built with --with-float=hard
DEFAULTTUNE = "cortexa9hf-neon"

SOC_FAMILY = "coolstream"
MACHINE_FEATURES = "screen usbhost usbgadget ext2 nfs"

# uClibc external toolchain for HD2 generation
TCLIBC ?= "uclibc"
TCMODE ?= "external-coolstream"

# uClibc is not compatible with systemd - init system is auto-selected in distro config
DISTRO_FEATURES:remove = "systemd"

IMAGE_FSTYPES ?= "tar.gz"
KERNEL_IMAGETYPE ?= "zImage"

SERIAL_CONSOLES ?= "115200;ttyAS0"

PREFERRED_PROVIDER_virtual/kernel ?= "linux-coolstream"
PREFERRED_VERSION_virtual/kernel ?= "3.10.93"

MACHINE_ESSENTIAL_EXTRA_RRECOMMENDS += "cst-drivers"

MACHINEOVERRIDES =. "${MACHINE}:coolstream:coolstream-hd2:kronos:"
```

## meta-coolstream/conf/machine/coolstream-nevis.conf
```bitbake
#@TYPE: Machine
#@NAME: Coolstream HD1/NEO/ZEE/NEO2 (Nevis, glibc)
#@DESCRIPTION: Coolstream HD1/NEO/ZEE/NEO2/NEO2 Twin (ARM1176, glibc)

require conf/machine/include/arm/armv6/tune-arm1176jz-s.inc

SOC_FAMILY = "coolstream"
MACHINE_FEATURES = "screen usbhost usbgadget ext2 nfs"

# glibc toolchain (default)
TCLIBC ?= "glibc"
TCMODE ?= "default"

IMAGE_FSTYPES ?= "tar.gz"
KERNEL_IMAGETYPE ?= "zImage"

SERIAL_CONSOLES ?= "115200;ttyAS0"

PREFERRED_PROVIDER_virtual/kernel ?= "linux-coolstream"
# HD1 bleibt auf 2.6.34.13 wegen Treiber-Kompatibilität; 2.6.34.15 steht optional bereit.
PREFERRED_VERSION_virtual/kernel ?= "2.6.34.13"

MACHINE_ESSENTIAL_EXTRA_RRECOMMENDS += "cst-drivers"
MACHINE_EXTRA_RRECOMMENDS += "cst-drivers-extra"

MACHINEOVERRIDES =. "${MACHINE}:coolstream:coolstream-hd1:nevis:"
```

## meta-coolstream/conf/machine/coolstream-shiner.conf
```bitbake
#@TYPE: Machine
#@NAME: Coolstream Trinity (shiner, uClibc toolchain)
#@DESCRIPTION: Coolstream Trinity V1 (HD2, Cortex-A9, uClibc/external toolchain)

require conf/machine/include/tune-cortexa9hf-neon.inc

SOC_FAMILY = "coolstream"
MACHINE_FEATURES = "screen usbhost usbgadget ext2 nfs"

# uClibc external toolchain for HD2 generation
TCLIBC ?= "uclibc"
TCMODE ?= "external-coolstream"

IMAGE_FSTYPES ?= "tar.gz"
KERNEL_IMAGETYPE ?= "zImage"

SERIAL_CONSOLES ?= "115200;ttyAS0"

PREFERRED_PROVIDER_virtual/kernel ?= "linux-coolstream"
PREFERRED_VERSION_virtual/kernel ?= "3.10.93"

MACHINE_ESSENTIAL_EXTRA_RRECOMMENDS += "cst-drivers"

MACHINEOVERRIDES =. "${MACHINE}:coolstream:coolstream-hd2:shiner:"
```

## meta-coolstream/conf/machine/coolstream-tank.conf
```bitbake
#@TYPE: Machine
#@NAME: Coolstream Tank
#@DESCRIPTION: Coolstream Tank (HD2, Cortex-A9, uClibc toolchain)

require conf/machine/include/arm/armv7a/tune-cortexa9.inc

# Coolstream toolchain is built with --with-float=hard
DEFAULTTUNE = "cortexa9hf-neon"

SOC_FAMILY = "coolstream"
MACHINE_FEATURES = "screen usbhost usbgadget ext2 nfs"

# Use uClibc external toolchain for Coolstream HD2
TCLIBC ?= "uclibc"
TCMODE ?= "external-coolstream"

# uClibc is not compatible with systemd - init system is auto-selected in distro config
DISTRO_FEATURES:remove = "systemd"

IMAGE_FSTYPES ?= "tar.gz"
KERNEL_IMAGETYPE ?= "zImage"
UBOOT_ENTRYPOINT ?= "0x80008000"
UBOOT_LOADADDRESS ?= "0x80008000"

SERIAL_CONSOLES ?= "115200;ttyAS0"

PREFERRED_PROVIDER_virtual/kernel ?= "linux-coolstream"
PREFERRED_VERSION_virtual/kernel ?= "3.10.93"

MACHINE_ESSENTIAL_EXTRA_RRECOMMENDS += "cst-drivers"

# Coolstream-specific overrides
MACHINEOVERRIDES =. "${MACHINE}:coolstream:coolstream-hd2:tank:"
```

## meta-libcoolstream/conf/layer.conf
```bitbake
# Layer configuration for meta-libcoolstream

BBPATH .= ":${LAYERDIR}"
BBFILES += "${LAYERDIR}/recipes-*/*/*.bb ${LAYERDIR}/recipes-*/*/*.bbappend"

BBFILE_COLLECTIONS += "libcoolstream"
BBFILE_PATTERN_libcoolstream = "^${LAYERDIR}/"
BBFILE_PRIORITY_libcoolstream = "12"

# No hard deps; relies on core classes only
LAYERDEPENDS_libcoolstream = "core"
```

## meta-local/conf/layer.conf
```bitbake
# Layer configuration for meta-local
# User customization layer for Tuxbox-OS

BBPATH .= ":${LAYERDIR}"

BBFILES += "${LAYERDIR}/recipes*/*/*.bb \
            ${LAYERDIR}/recipes*/*/*.bbappend"

BBFILE_COLLECTIONS += "meta-local"
BBFILE_PATTERN_meta-local := "^${LAYERDIR}/"
BBFILE_PRIORITY_meta-local = "15"

LAYERSERIES_COMPAT_meta-local = "kirkstone"

# Dependencies
LAYERDEPENDS_meta-local = "core"

# Remove OE-Alliance legacy Python 2 requirements (not needed for Neutrino)
HOSTTOOLS:remove = "python python2 python2.7 sshpass"

# Disable PACKAGE_ARCHS sanity check
# OE-Alliance machine configs set DEFAULTTUNE before including tune files,
# causing tune-specific PACKAGE_EXTRA_ARCHS overrides to not apply.
# This is a known incompatibility between OE-Alliance and standard Yocto workflow.
# Disable the sanity check that fails during bitbake -p
INHERIT:remove = "sanity"

# Mask OE-Alliance recipes not needed for Neutrino builds (Enigma2-specific)
# Use absolute paths and comprehensive patterns
BBMASK .= "|.*/oe-alliance/meta-oe/recipes-distros/"
BBMASK .= "|.*/oe-alliance/meta-oe/recipes-oe-alliance/enigma2.*"
BBMASK .= "|.*/oe-alliance/.*kodi.*"
BBMASK .= "|.*/oe-alliance/meta-oe/recipes-multimedia/gstreamer1.0/.*dvbmediasink.*"
# Mask brand-specific Kodi recipes (breaks parsing without SRCREV_FORMAT)
BBMASK .= "|.*/meta-brands/.*/recipes-kodi/.*"
```

## meta-local/conf/machine/hd51.conf
```bitbake
# HD51 machine configuration overrides for Tuxbox-OS
# Fixes PACKAGE_ARCHS sanity check for Kirkstone

# OE-Alliance sets DEFAULTTUNE before including tune files, causing
# PACKAGE_EXTRA_ARCHS tune-specific overrides to not apply.
# Explicitly set the package architecture list for cortexa15hf-neon-vfpv4.

require conf/machine/include/arm/arch-armv7ve.inc

# Explicitly construct PACKAGE_EXTRA_ARCHS for cortexa15hf-neon-vfpv4 tune
# Based on poky/meta/conf/machine/include/arm/armv7a/tune-cortexa15.inc
PACKAGE_EXTRA_ARCHS = "all any noarch allarch armv4 armv4t armv5te armv6 armv6hf armv7a armv7ahf armv7ve armv7vehf armv7vehf-vfp armv7vehf-neon armv7vehf-neon-vfpv4 cortexa15hf-vfp cortexa15hf-neon cortexa15hf-neon-vfpv4"
```

## meta-tuxbox-toolchain/conf/distro/include/coolstream-external-toolchain.inc
```bitbake
# Coolstream External Toolchain Configuration

# Toolchain mode
TCMODE = "external-coolstream"

# Toolchain paths (will be set by external-toolchain recipe)
EXTERNAL_TOOLCHAIN ?= "${TMPDIR}/work-shared/external-toolchain"

# Target prefix
TARGET_PREFIX = "arm-cortex-linux-uclibcgnueabi-"

# Skip native toolchain recipes
ASSUME_PROVIDED += " \
    gcc-cross-${TARGET_ARCH} \
    binutils-cross-${TARGET_ARCH} \
    uclibc \
    virtual/${TARGET_PREFIX}gcc \
    virtual/${TARGET_PREFIX}g++ \
    virtual/${TARGET_PREFIX}gcc-initial \
    virtual/${TARGET_PREFIX}binutils \
    virtual/${TARGET_PREFIX}libc-for-gcc \
    virtual/${TARGET_PREFIX}compilerlibs \
    linux-libc-headers \
    virtual/${TARGET_PREFIX}linux-libc-headers \
    gcc-runtime \
    libssp-nonshared \
    nativesdk-gcc-runtime \
    nativesdk-libgcc \
    nativesdk-glibc \
    nativesdk-linux-libc-headers \
    gcc-cross-canadian-${TRANSLATED_TARGET_ARCH} \
    binutils-cross-canadian-${TRANSLATED_TARGET_ARCH} \
    gcc-crosssdk-${SDK_SYS} \
    binutils-crosssdk-${SDK_SYS} \
"

# Toolchain features
TOOLCHAIN_FEATURES = "toolchain-uClibc"

# Prefer the external toolchain for all compiler/libc virtuals
PREFERRED_PROVIDER_virtual/${TARGET_PREFIX}binutils = "external-toolchain-coolstream"
PREFERRED_PROVIDER_virtual/${TARGET_PREFIX}gcc = "external-toolchain-coolstream"
PREFERRED_PROVIDER_virtual/${TARGET_PREFIX}g++ = "external-toolchain-coolstream"
PREFERRED_PROVIDER_virtual/${TARGET_PREFIX}compilerlibs = "external-toolchain-coolstream"
PREFERRED_PROVIDER_virtual/${TARGET_PREFIX}linux-libc-headers = "external-toolchain-coolstream"
PREFERRED_PROVIDER_virtual/libc = "external-toolchain-coolstream"
PREFERRED_PROVIDER_linux-libc-headers = "external-toolchain-coolstream"
```

## meta-tuxbox-toolchain/conf/distro/include/tclibc-uclibc.inc
```bitbake
# Minimal TCLIBC include for external uClibc toolchain

TCLIBC = "uclibc"
TCLIBCAPPEND = "uclibc"
```

## meta-tuxbox-toolchain/conf/distro/include/tcmode-external-coolstream.inc
```bitbake
# Toolchain mode include for Coolstream external uClibc toolchain

require conf/distro/include/coolstream-external-toolchain.inc

# Pull in toolchain setup
INHERIT += "external-toolchain-coolstream"

# Avoid Yocto musl and cross-canadian SDK toolchains that conflict with the
# prebuilt uClibc toolchain.
BBMASK:append = "|.*/musl/.*|.*/cross-canadian/.*|.*/nativesdk-.*|.*/go-cross-.*|.*/rust-.*"
```

## meta-tuxbox-toolchain/conf/distro/tuxbox-uclibc.conf
```bitbake
# Tuxbox-OS uClibc Distribution Configuration
#
# Distribution for Coolstream Tank and other uClibc-based devices

# Inherit base Tuxbox configuration
require conf/distro/tuxbox.conf

# Distribution identity override
DISTRO_NAME = "Tuxbox-OS uClibc"
DISTRO_VERSION:append = "-uclibc"

# C Library
TCLIBC = "uclibc"
TCMODE = "external-coolstream"

# Disable systemd features incompatible with uClibc
DISTRO_FEATURES:remove = "systemd-resolved"

# Kernel version for Coolstream
PREFERRED_VERSION_linux-coolstream ?= "3.10.93"

# Toolchain configuration (staged by external-toolchain-coolstream)
EXTERNAL_TOOLCHAIN_ROOT ?= "${STAGING_DIR_NATIVE}/usr/share/coolstream-toolchain/toolchain-coolstream-uclibc-armv7"
EXTERNAL_TOOLCHAIN_BIN ?= "${EXTERNAL_TOOLCHAIN_ROOT}/cross/arm-linux-3.10.93/bin"
EXTERNAL_TOOLCHAIN_SYSROOT ?= "${EXTERNAL_TOOLCHAIN_ROOT}/cross/arm-linux-3.10.93/arm-cortex-linux-uclibcgnueabi/sys-root"

# Target architecture
TARGET_ARCH = "arm"
TARGET_VENDOR = "-cortex"
TARGET_OS = "linux-uclibcgnueabi"

# External toolchain provides libc/crypt; use target providers for iconv/intl
PREFERRED_PROVIDER_virtual/libc = "external-toolchain-coolstream"
PREFERRED_PROVIDER_virtual/crypt = "external-toolchain-coolstream"
PREFERRED_PROVIDER_virtual/libintl = "proxy-libintl"
PREFERRED_PROVIDER_virtual/libiconv = "libiconv"

# Package exclusions for uClibc incompatibility
RDEPENDS:packagegroup-tuxbox-base:remove = "systemd-resolved"

# uClibc-specific optimizations
FULL_OPTIMIZATION = "-Os -pipe ${DEBUG_FLAGS}"

# QA: skip arch check because linux-uclibcgnueabi is not in oe.elf.machine_dict
INSANE_SKIP:append = " arch"

# GCC 6.x does not support -fmacro-prefix-map, keep only debug-prefix-map
DEBUG_PREFIX_MAP = "-fdebug-prefix-map=${WORKDIR}=/usr/src/debug/${PN}/${EXTENDPE}${PV}-${PR} \
                     -fdebug-prefix-map=${STAGING_DIR_HOST}= \
                     -fdebug-prefix-map=${STAGING_DIR_NATIVE}= \
"

# External toolchain: avoid SDK/cross-canadian packagegroups
TOOLCHAIN_HOST_TASK = ""
TOOLCHAIN_HOST_TASK_ATTEMPTONLY = ""
TOOLCHAIN_TARGET_TASK = ""
TOOLCHAIN_TARGET_TASK_ATTEMPTONLY = ""

# Default host SDK architecture (SDKs are not built by default, but sanity needs a valid value)
SDKMACHINE ?= "x86_64"
```

## meta-tuxbox-toolchain/conf/layer.conf
```bitbake
# Layer configuration for meta-tuxbox-toolchain
#
# External toolchain support for Tuxbox-OS (e.g., Coolstream uClibc)

# We have a conf and classes directory, add to BBPATH
BBPATH .= ":${LAYERDIR}"

# We have recipes-* directories, add to BBFILES
BBFILES += "${LAYERDIR}/recipes-*/*/*.bb \
            ${LAYERDIR}/recipes-*/*/*.bbappend"

BBFILE_COLLECTIONS += "tuxbox-toolchain"
BBFILE_PATTERN_tuxbox-toolchain := "^${LAYERDIR}/"
BBFILE_PRIORITY_tuxbox-toolchain = "9"

# Layer compatibility
LAYERSERIES_COMPAT_tuxbox-toolchain = "kirkstone"

# Layer dependencies
LAYERDEPENDS_tuxbox-toolchain = "core tuxbox"

# Layer information
LAYERVERSION_tuxbox-toolchain = "1"
LAYER_CONF_VERSION ?= "1"
```

## meta-tuxbox-toolchain/conf/machine/include/coolstream-common.inc
```bitbake
# Common Coolstream machine configuration

# SOC Family
SOC_FAMILY = "coolstream"

# Machine class
MACHINE_CLASS = "stb"

# External toolchain
require conf/distro/include/coolstream-external-toolchain.inc

# Preferred providers
PREFERRED_PROVIDER_virtual/kernel = "linux-coolstream"
PREFERRED_PROVIDER_virtual/libstb-hal = "libstb-hal-coolstream"

# MTD support
MACHINE_FEATURES += "mtd"

# Kernel modules
MACHINE_ESSENTIAL_EXTRA_RRECOMMENDS = " \
    kernel-module-dvb-core \
    kernel-module-coolstream-dvb \
"

# Build configuration
MACHINE_FEATURES_BACKFILL_CONSIDERED += "rtc"
```

## meta-tuxbox-toolchain/conf/machine/tank.conf
```bitbake
#@TYPE: Machine
#@NAME: Coolstream Tank
#@DESCRIPTION: Machine configuration for Coolstream Tank (ARM Cortex-A9, uClibc)

# Include common Coolstream settings
require conf/machine/include/coolstream-common.inc

# Machine identification
MACHINE_NAME = "Coolstream Tank"

# Machine features
MACHINE_FEATURES = " \
    wifi \
    bluetooth \
    usbhost \
    hdmi \
    dvb-s \
    dvb-s2 \
    ci \
    alsa \
"

# Kernel
PREFERRED_PROVIDER_virtual/kernel = "linux-coolstream"
PREFERRED_VERSION_linux-coolstream = "3.10.93"

# Bootloader
PREFERRED_PROVIDER_virtual/bootloader = "u-boot-coolstream"

# Architecture
DEFAULTTUNE = "armv7ahf-neon"
require conf/machine/include/arm/armv7a/tune-cortexa9.inc

# Console
SERIAL_CONSOLES = "115200;ttyS0"

# Image
MACHINE_ESSENTIAL_EXTRA_RDEPENDS = " \
    kernel-modules \
    firmware-coolstream \
"

MACHINE_EXTRA_RDEPENDS = " \
    coolstream-drivers \
    libstb-hal-coolstream \
"

# Display
MACHINE_LCD_DISPLAY = "textlcd"

# Flash layout
FLASHSIZE = "128"
KERNEL_DEVICETREE = "coolstream-tank.dtb"

# Image format
IMAGE_FSTYPES = "tar.bz2 ext4"

# Kernel image type
KERNEL_IMAGETYPE = "zImage"
KERNEL_ALT_IMAGETYPE = "uImage"

# U-Boot configuration
UBOOT_MACHINE = "coolstream_tank_config"
UBOOT_ENTRYPOINT = "0x80008000"
UBOOT_LOADADDRESS = "0x80008000"

# Root filesystem
IMAGE_ROOTFS_SIZE ?= "262144"
```
