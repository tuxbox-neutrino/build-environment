## meta-tuxbox/conf/distro/tuxbox.conf
```bitbake
# Tuxbox-OS Distribution Configuration
#
# Distribution for Tuxbox-Neutrino (not Enigma2)
# Based on OE-Alliance infrastructure

require conf/distro/poky.conf

# Distribution identity
DISTRO = "tuxbox"
DISTRO_NAME = "Tuxbox-OS"
DISTRO_VERSION = "1.0"
DISTRO_CODENAME = "kirkstone"

# Maintainer
MAINTAINER = "Tuxbox Neutrino Team <team@tuxbox-neutrino.org>"

# Distribution features (NO Enigma2-specific features)
DISTRO_FEATURES = "systemd \
                   alsa \
                   bluetooth \
                   nfs \
                   zeroconf \
                   pam \
                   ipv4 \
                   ipv6 \
                   wifi \
                   largefile \
                   opengl \
                   usbhost \
                   usbgadget \
                   ext2 \
                   vfat \
                   "

# Remove sysvinit, use systemd exclusively
DISTRO_FEATURES_BACKFILL_CONSIDERED += "sysvinit"

# Virtual providers - Use Neutrino instead of Enigma2
PREFERRED_PROVIDER_virtual/egl ?= "mesa"
PREFERRED_PROVIDER_virtual/libgl ?= "mesa"
PREFERRED_PROVIDER_virtual/libgles2 ?= "mesa"
PREFERRED_PROVIDER_virtual/libgbm:class-native = "mesa"
PREFERRED_PROVIDER_virtual/libgbm:class-nativesdk = "mesa"

# Init system
VIRTUAL-RUNTIME_init_manager = "systemd"
VIRTUAL-RUNTIME_initscripts = "systemd-compat-units"
VIRTUAL-RUNTIME_login_manager = "shadow-base"
VIRTUAL-RUNTIME_dev_manager = "systemd"

# Skip host SDK packagegroup to avoid pulling unusable nativesdk deps
TOOLCHAIN_HOST_TASK:remove = "nativesdk-packagegroup-sdk-host"

# Package management
PACKAGE_CLASSES ?= "package_ipk"
EXTRA_IMAGE_FEATURES ?= "debug-tweaks"
PACKAGE_EXTRA_ARCHS:remove = "${TUNE_PKGARCH}"
LICENSE_FLAGS_ACCEPTED:append = " commercial"



# Image naming
IMAGE_NAME = "${IMAGE_BASENAME}-${MACHINE}-${DATETIME}"
IMAGE_NAME[vardepsexclude] = "DATETIME"
IMAGE_VERSION ?= "${DISTRO_VERSION}"
IMAGE_NAME_SUFFIX = ".tuxbox"

# Optimization flags
# Default to size optimization
FULL_OPTIMIZATION = "-Os -pipe ${DEBUG_FLAGS}"

# Performance-critical packages get -O3
FULL_OPTIMIZATION:pn-flac = "-O3 -pipe ${DEBUG_FLAGS}"
FULL_OPTIMIZATION:pn-libogg = "-O3 -pipe ${DEBUG_FLAGS}"
FULL_OPTIMIZATION:pn-libvorbis = "-O3 -pipe ${DEBUG_FLAGS}"
FULL_OPTIMIZATION:pn-zlib = "-O3 -pipe ${DEBUG_FLAGS}"
FULL_OPTIMIZATION:pn-libpng = "-O3 -pipe ${DEBUG_FLAGS}"
FULL_OPTIMIZATION:pn-ffmpeg = "-O3 -pipe ${DEBUG_FLAGS}"
FULL_OPTIMIZATION:pn-gstreamer1.0 = "-O3 -pipe ${DEBUG_FLAGS}"

# Stability-critical packages get -O2
FULL_OPTIMIZATION:pn-systemd = "-O2 -pipe ${DEBUG_FLAGS}"
FULL_OPTIMIZATION:pn-busybox = "-O2 -pipe ${DEBUG_FLAGS}"
FULL_OPTIMIZATION:pn-openssl = "-O2 -pipe ${DEBUG_FLAGS}"

# Toolchain
TCLIBC ?= "glibc"
TCMODE ?= "default"

# GCC configuration
GCCVERSION ?= "11.%"
SDKGCCVERSION ?= "${GCCVERSION}"

# Kernel
PREFERRED_PROVIDER_virtual/kernel ?= "linux-yocto"
PREFERRED_VERSION_linux-yocto ?= "5.15%"

# Include OE-Alliance shared configurations if available
include conf/distro/include/unstable-versions.inc

# Feed configuration
DISTRO_FEED_URI ?= "http://feed.tuxbox-neutrino.org/${DISTRO_VERSION}"
DISTRO_FEED_PREFIX ?= "tuxbox"

# SDK configuration
SDK_NAME = "${DISTRO}-${TCLIBC}-${SDKMACHINE}-${IMAGE_BASENAME}-${TUNE_PKGARCH}-${MACHINE}"
SDKPATH = "/opt/${DISTRO}/${SDK_VERSION}"

# Default timezone
DEFAULT_TIMEZONE ?= "Europe/Berlin"

# Locale support
IMAGE_LINGUAS ?= "en-us en-gb de-de fr-fr"

# Neutrino flavour selection
FLAVOUR ?= "tuxbox"

# Additional DISTRO-specific packages
DISTRO_EXTRA_RDEPENDS += " \
    "

DISTRO_EXTRA_RRECOMMENDS += " \
    "

# Drop Enigma2-only extras pulled in by OE-Alliance machine configs
EXTRA_IMAGEDEPENDS:remove = "enigma2-plugin-systemplugins-remotecontrolcode"
MACHINE_EXTRA_RDEPENDS:remove = "enigma2-plugin-systemplugins-remotecontrolcode"

# Build type
DISTRO_TYPE ?= "release"

# Release build settings
INHERIT += "${@bb.utils.contains('DISTRO_TYPE', 'release', 'rm_work', '', d)}"

# Development build settings
INHERIT += "${@bb.utils.contains('DISTRO_TYPE', 'development', 'buildhistory buildstats', '', d)}"
BUILDHISTORY_COMMIT ?= "1"

# Version information
TUXBOX_VERSION = "${DISTRO_VERSION}"
TUXBOX_BUILD_DATE = "${DATETIME}"
TUXBOX_BUILD_DATE[vardepsexclude] = "DATETIME"

# Force masking of Enigma2/OE-A distro content after machine configs are parsed
BBMASK:append = "|.*/oe-alliance/meta-oe/recipes-distros/.*|.*/oe-alliance/meta-oe/recipes-oe-alliance/enigma2-plugins/.*|.*/oe-alliance/meta-oe/recipes-oe-alliance/enigma2-skins.*|.*/oe-alliance/meta-oe/recipes-oe-alliance/enigma2-.*|.*/oe-alliance/meta-oe/.*enigma2.*|.*/enigma2-plugin-skins-.*|.*/enigma2-plugin-extensions-tuxcom.*|.*/hotplug-e2-helper.*|.*/enigma2-plugin-softcams-.*|.*/meta-oe/recipes-oe-alliance/enigma2/.*|.*/oe-alliance/meta-oe/recipes-oe-alliance/enigma2/.*|.*/oe-alliance/meta-oe/recipes-oe-alliance/enigma2-skins/.*|.*/aio-grab.*|.*/enigma2-plugin-skins.*|.*/enigma2-plugin-skins-kiddac-1080-slyk-r19.*|.*/enigma2-plugins/.*|.*/enigma2-plugin-.*|.*/enigma2-pliplugins.*|.*/gstreamer1.0-plugin-subsink.*|.*/gstreamer1.0-plugin-dvbmediasink.*|.*/jedimakerxtream.*|.*/recipes-qt5.15/qt5/.*|.*/meta-neutrino/recipes-qt/qt5/.*|.*/oe-alliance/meta-oe/recipes-devtools/gcc/.*11.2.*|.*/edid-decode.*"
BBMASK:append = "|.*/neutrino-hd-cs2_.*"
```

## meta-tuxbox/conf/layer.conf
```bitbake
# Layer configuration for meta-tuxbox
#
# This layer provides the Tuxbox-OS distribution for Neutrino
# Compatible with OE-Alliance and Yocto Kirkstone

# We have a conf and classes directory, add to BBPATH
BBPATH .= ":${LAYERDIR}"

# We have recipes-* directories, add to BBFILES (with and without subdirs)
BBFILES += "${LAYERDIR}/recipes-*/*.bb \
            ${LAYERDIR}/recipes-*/*.bbappend \
            ${LAYERDIR}/recipes-*/*/*.bb \
            ${LAYERDIR}/recipes-*/*/*.bbappend \
            ${LAYERDIR}/recipes-*/*/*/*.bb \
            ${LAYERDIR}/recipes-*/*/*/*.bbappend"

BBFILE_COLLECTIONS += "tuxbox"
BBFILE_PATTERN_tuxbox := "^${LAYERDIR}/"
BBFILE_PRIORITY_tuxbox = "11"

# Layer compatibility
LAYERSERIES_COMPAT_tuxbox = "kirkstone"

# Layer dependencies
LAYERDEPENDS_tuxbox = "core openembedded-layer"

# Additional license directories
LICENSE_PATH += "${LAYERDIR}/files/custom-licenses"

# Layer information
LAYERVERSION_tuxbox = "1"
LAYER_CONF_VERSION ?= "1"

# Global mask to keep Enigma2 content out of Neutrino builds
BBMASK ?= ".*enigma2.*|.*/oe-alliance/meta-oe/recipes-distros/.*|.*/oe-alliance/meta-oe/recipes-oe-alliance/enigma2-plugins/.*|.*/oe-alliance/meta-oe/recipes-oe-alliance/enigma2-skins.*|.*/oe-alliance/meta-oe/recipes-oe-alliance/enigma2-.*"

# Mask Enigma2-specific content from OE-Alliance we do not use for Neutrino
# Keep OA hardware/brand support intact.
BBMASK .= "|.*/oe-alliance/meta-oe/recipes-distros/"
BBMASK .= "|.*/oe-alliance/meta-oe/recipes-oe-alliance/enigma2.*"
BBMASK .= "|.*/oe-alliance/meta-oe/recipes-oe-alliance/enigma2-skins.*"
BBMASK .= "|.*/oe-alliance/meta-oe/recipes-multimedia/gstreamer1.0/.*dvbmediasink.*"
BBMASK .= "|.*/enigma2-plugins/.*"
BBMASK .= "|.*/enigma2-plugin-.*"
BBMASK .= "|.*/enigma2-pliplugins.*"
BBMASK .= "|.*/oe-alliance/meta-oe/recipes-oe-alliance/enigma2/.*"
BBMASK .= "|.*/gstreamer1.0-plugin-subsink.*"
BBMASK .= "|.*/jedimakerxtream.*"
BBMASK .= "|.*/oe-alliance/meta-oe/recipes-core/base-files/base-files_3.0.14.bbappend"

# Remove legacy hosttool requirements not needed for Neutrino
HOSTTOOLS:remove = "python python2 python2.7 sshpass"
```
